/* a2ltool 1.6.0 */ ASAP2_VERSION 1 71
/begin PROJECT test_project ""
/begin MODULE test_module ""
/begin INSTANCE reg "" RegDef 0x9070 SYMBOL_LINK "reg" 0 /end INSTANCE
/begin INSTANCE basic "" BasicData 0x90B8 SYMBOL_LINK "basic" 0 /end INSTANCE
/begin INSTANCE val_u8 "" Parameter_UByte 0x9038 SYMBOL_LINK "val_u8" 0 /end INSTANCE
/begin INSTANCE val_u16 "" Parameter_UWord 0x903A SYMBOL_LINK "val_u16" 0 /end INSTANCE
/begin INSTANCE val_u32 "" Parameter_ULong 0x903C SYMBOL_LINK "val_u32" 0 /end INSTANCE
/begin INSTANCE val_u64 "" Parameter_UInt64 0x9040 SYMBOL_LINK "val_u64" 0 /end INSTANCE
/begin INSTANCE val_i8 "" Parameter_SByte 0x9048 SYMBOL_LINK "val_i8" 0 /end INSTANCE
/begin INSTANCE val_i16 "" Parameter_SWord 0x904A SYMBOL_LINK "val_i16" 0 /end INSTANCE
/begin INSTANCE val_i32 "" Parameter_SLong 0x904C SYMBOL_LINK "val_i32" 0 /end INSTANCE
/begin INSTANCE val_i64 "" Parameter_SInt64 0x9050 SYMBOL_LINK "val_i64" 0 /end INSTANCE
/begin INSTANCE val_f "" Parameter_Float32 0x9058 SYMBOL_LINK "val_f" 0 /end INSTANCE
/begin INSTANCE val_d "" Parameter_Double 0x9060 SYMBOL_LINK "val_d" 0 /end INSTANCE
/begin INSTANCE val_e "" MyEnum_Copy1 0x9068 SYMBOL_LINK "val_e" 0 /end INSTANCE
/begin INSTANCE val_ptr "" LongPointer_void 0x906C SYMBOL_LINK "val_ptr" 0 /end INSTANCE
/begin INSTANCE struct_b "" StructB 0x9078 SYMBOL_LINK "struct_b" 0 /end INSTANCE
/begin INSTANCE TEST_struct "" TestStruct 0x90C0 SYMBOL_LINK "TEST_struct" 0 /end INSTANCE
/begin INSTANCE TEST_structarr "" TestStruct 0x90C4 MATRIX_DIM 10 SYMBOL_LINK "TEST_structarr" 0 /end INSTANCE
/begin INSTANCE TEST_structarr_arr "" TestStruct 0x90EC MATRIX_DIM 2 10 SYMBOL_LINK "TEST_structarr_arr" 0 /end INSTANCE
/begin INSTANCE TEST_structarr_ptr "" TestStruct 0x9018 ADDRESS_TYPE PLONG MATRIX_DIM 10 SYMBOL_LINK "TEST_structarr_ptr" 0 /end INSTANCE
/begin INSTANCE TEST_structarr_ptr_arr "" LongPointer_Array_10_TestStruct 0x901C MATRIX_DIM 2 SYMBOL_LINK "TEST_structarr_ptr_arr" 0 /end INSTANCE
/begin INSTANCE TEST_structptr "" TestStruct 0x9010 ADDRESS_TYPE PLONG SYMBOL_LINK "TEST_structptr" 0 /end INSTANCE
/begin INSTANCE TEST_structptr_arr "" LongPointer_TestStruct 0x9024 MATRIX_DIM 4 SYMBOL_LINK "TEST_structptr_arr" 0 /end INSTANCE
/begin INSTANCE TEST_structptr_arr_ptr "" LongPointer_TestStruct 0x9034 ADDRESS_TYPE PLONG MATRIX_DIM 4 SYMBOL_LINK "TEST_structptr_arr_ptr" 0 /end INSTANCE
/begin INSTANCE TEST_structptr_ptr "" LongPointer_TestStruct 0x9014 ADDRESS_TYPE PLONG SYMBOL_LINK "TEST_structptr_ptr" 0 /end INSTANCE
/begin TYPEDEF_MEASUREMENT Measurement_ULong "" ULONG NO_COMPU_METHOD 0 0 0 4294967295 /end TYPEDEF_MEASUREMENT
/begin TYPEDEF_MEASUREMENT Measurement_Float32 "" FLOAT32_IEEE NO_COMPU_METHOD 0 0 -3.4028234663852886e38 3.4028234663852886e38 /end TYPEDEF_MEASUREMENT
/begin TYPEDEF_MEASUREMENT Measurement_UInt64 "" A_UINT64 NO_COMPU_METHOD 0 0 0 1.8446744073709552e19 /end TYPEDEF_MEASUREMENT
/begin TYPEDEF_MEASUREMENT Measurement_ULong_0x1F "" ULONG NO_COMPU_METHOD 0 0 0 31 BIT_MASK 0x1F /end TYPEDEF_MEASUREMENT
/begin TYPEDEF_MEASUREMENT Measurement_ULong_0x3E0 "" ULONG NO_COMPU_METHOD 0 0 0 31 BIT_MASK 0x3E0 /end TYPEDEF_MEASUREMENT
/begin TYPEDEF_MEASUREMENT Measurement_ULong_0x7C00 "" ULONG NO_COMPU_METHOD 0 0 0 31 BIT_MASK 0x7C00 /end TYPEDEF_MEASUREMENT
/begin TYPEDEF_MEASUREMENT Measurement_ULong_0xF8000 "" ULONG NO_COMPU_METHOD 0 0 0 31 BIT_MASK 0xF8000 /end TYPEDEF_MEASUREMENT
/begin TYPEDEF_MEASUREMENT MyEnum "" UWORD MyEnum 0 0 20 11111 /end TYPEDEF_MEASUREMENT
/begin TYPEDEF_STRUCTURE LongPointer_Array_10_TestStruct "" 0x28 ADDRESS_TYPE PLONG /begin STRUCTURE_COMPONENT array_element TestStruct 0 MATRIX_DIM 10 /end STRUCTURE_COMPONENT SYMBOL_TYPE_LINK "TestStruct" /end TYPEDEF_STRUCTURE
/begin TYPEDEF_STRUCTURE LongPointer_TestStruct "" 0x4 ADDRESS_TYPE PLONG /begin STRUCTURE_COMPONENT value Measurement_ULong 0 SYMBOL_TYPE_LINK "value" /end STRUCTURE_COMPONENT SYMBOL_TYPE_LINK "TestStruct" /end TYPEDEF_STRUCTURE
/begin TYPEDEF_STRUCTURE TestStruct "" 0x4 /begin STRUCTURE_COMPONENT value Measurement_ULong 0 SYMBOL_TYPE_LINK "value" /end STRUCTURE_COMPONENT SYMBOL_TYPE_LINK "TestStruct" /end TYPEDEF_STRUCTURE
/begin TYPEDEF_STRUCTURE RegDef "" 0x4 /begin STRUCTURE_COMPONENT Value Measurement_ULong 0 SYMBOL_TYPE_LINK "Value" /end STRUCTURE_COMPONENT
 /begin STRUCTURE_COMPONENT Bits_ABC Measurement_ULong_0x1F 0 SYMBOL_TYPE_LINK "Bits_ABC" /end STRUCTURE_COMPONENT
 /begin STRUCTURE_COMPONENT Bits_DEF Measurement_ULong_0x3E0 0 SYMBOL_TYPE_LINK "Bits_DEF" /end STRUCTURE_COMPONENT
 /begin STRUCTURE_COMPONENT Bits_GHI Measurement_ULong_0x7C00 0 SYMBOL_TYPE_LINK "Bits_GHI" /end STRUCTURE_COMPONENT
 /begin STRUCTURE_COMPONENT Bits_JKL Measurement_ULong_0xF8000 0 SYMBOL_TYPE_LINK "Bits_JKL" /end STRUCTURE_COMPONENT
 SYMBOL_TYPE_LINK "RegDef" /end TYPEDEF_STRUCTURE
/begin TYPEDEF_STRUCTURE StructA "" 0x18 /begin STRUCTURE_COMPONENT enumval MyEnum 0 SYMBOL_TYPE_LINK "enumval" /end STRUCTURE_COMPONENT /begin STRUCTURE_COMPONENT val_i32 Measurement_ULong 4 SYMBOL_TYPE_LINK "val_i32" /end STRUCTURE_COMPONENT /begin STRUCTURE_COMPONENT val_i64 Measurement_UInt64 8 SYMBOL_TYPE_LINK "val_i64" /end STRUCTURE_COMPONENT /begin STRUCTURE_COMPONENT val_f32 Measurement_Float32 16 SYMBOL_TYPE_LINK "val_f32" /end STRUCTURE_COMPONENT SYMBOL_TYPE_LINK "StructA" /end TYPEDEF_STRUCTURE
/begin TYPEDEF_STRUCTURE StructB "" 0x40
 /begin STRUCTURE_COMPONENT pPrev StructB 0 ADDRESS_TYPE PLONG SYMBOL_TYPE_LINK "pPrev" /end STRUCTURE_COMPONENT
 /begin STRUCTURE_COMPONENT pNext StructB 4 ADDRESS_TYPE PLONG SYMBOL_TYPE_LINK "pNext" /end STRUCTURE_COMPONENT
 /begin STRUCTURE_COMPONENT s1 StructA 8 SYMBOL_TYPE_LINK "s1" /end STRUCTURE_COMPONENT
 /begin STRUCTURE_COMPONENT s2 StructA 32 SYMBOL_TYPE_LINK "s2" /end STRUCTURE_COMPONENT
 SYMBOL_TYPE_LINK "StructB" /end TYPEDEF_STRUCTURE
/begin TYPEDEF_STRUCTURE BasicData "" 0x0 SYMBOL_TYPE_LINK "BasicData" /end TYPEDEF_STRUCTURE
/begin COMPU_METHOD MyEnum "Conversion table for enum MyEnum" TAB_VERB "%.4" "" COMPU_TAB_REF MyEnum /end COMPU_METHOD
/begin COMPU_VTAB MyEnum "Conversion table for enum MyEnum" TAB_VERB 3 20 "VALUE_2" 100 "VALUE_1" 11111 "VALUE_3" /end COMPU_VTAB
/begin RECORD_LAYOUT __A_INT64_Z FNC_VALUES 1 A_INT64 ROW_DIR DIRECT /end RECORD_LAYOUT
/begin RECORD_LAYOUT __A_UINT64_Z FNC_VALUES 1 A_UINT64 ROW_DIR DIRECT /end RECORD_LAYOUT
/begin RECORD_LAYOUT __FLOAT32_IEEE_Z FNC_VALUES 1 FLOAT32_IEEE ROW_DIR DIRECT /end RECORD_LAYOUT
/begin RECORD_LAYOUT __FLOAT64_IEEE_Z FNC_VALUES 1 FLOAT64_IEEE ROW_DIR DIRECT /end RECORD_LAYOUT
/begin RECORD_LAYOUT __SBYTE_Z FNC_VALUES 1 SBYTE ROW_DIR DIRECT /end RECORD_LAYOUT
/begin RECORD_LAYOUT __SLONG_Z FNC_VALUES 1 SLONG ROW_DIR DIRECT /end RECORD_LAYOUT
/begin RECORD_LAYOUT __SWORD_Z FNC_VALUES 1 SWORD ROW_DIR DIRECT /end RECORD_LAYOUT
/begin RECORD_LAYOUT __UBYTE_Z FNC_VALUES 1 UBYTE ROW_DIR DIRECT /end RECORD_LAYOUT
/begin RECORD_LAYOUT __ULONG_Z FNC_VALUES 1 ULONG ROW_DIR DIRECT /end RECORD_LAYOUT
/begin RECORD_LAYOUT __UWORD_Z FNC_VALUES 1 UWORD ROW_DIR DIRECT /end RECORD_LAYOUT
/begin TYPEDEF_BLOB LongPointer_void "" 4 ADDRESS_TYPE PLONG /end TYPEDEF_BLOB
/begin TYPEDEF_CHARACTERISTIC MyEnum_Copy1 "" VALUE __UWORD_Z 0 MyEnum 20 11111 /end TYPEDEF_CHARACTERISTIC
/begin TYPEDEF_CHARACTERISTIC Parameter_Double "" VALUE __FLOAT64_IEEE_Z 0 NO_COMPU_METHOD -1.7976931348623157e308 1.7976931348623157e308 /end TYPEDEF_CHARACTERISTIC
/begin TYPEDEF_CHARACTERISTIC Parameter_Float32 "" VALUE __FLOAT32_IEEE_Z 0 NO_COMPU_METHOD -3.4028234663852886e38 3.4028234663852886e38 /end TYPEDEF_CHARACTERISTIC
/begin TYPEDEF_CHARACTERISTIC Parameter_SByte "" VALUE __SBYTE_Z 0 NO_COMPU_METHOD -128 127 /end TYPEDEF_CHARACTERISTIC
/begin TYPEDEF_CHARACTERISTIC Parameter_SInt64 "" VALUE __A_INT64_Z 0 NO_COMPU_METHOD -9.223372036854776e18 9.223372036854776e18 /end TYPEDEF_CHARACTERISTIC
/begin TYPEDEF_CHARACTERISTIC Parameter_SLong "" VALUE __SLONG_Z 0 NO_COMPU_METHOD -2147483648 2147483647 /end TYPEDEF_CHARACTERISTIC
/begin TYPEDEF_CHARACTERISTIC Parameter_SWord "" VALUE __SWORD_Z 0 NO_COMPU_METHOD -32768 32767 /end TYPEDEF_CHARACTERISTIC
/begin TYPEDEF_CHARACTERISTIC Parameter_UByte "" VALUE __UBYTE_Z 0 NO_COMPU_METHOD 0 255 /end TYPEDEF_CHARACTERISTIC
/begin TYPEDEF_CHARACTERISTIC Parameter_UInt64 "" VALUE __A_UINT64_Z 0 NO_COMPU_METHOD 0 1.8446744073709552e19 /end TYPEDEF_CHARACTERISTIC
/begin TYPEDEF_CHARACTERISTIC Parameter_ULong "" VALUE __ULONG_Z 0 NO_COMPU_METHOD 0 4294967295 /end TYPEDEF_CHARACTERISTIC
/begin TYPEDEF_CHARACTERISTIC Parameter_UWord "" VALUE __UWORD_Z 0 NO_COMPU_METHOD 0 65535 /end TYPEDEF_CHARACTERISTIC
/end MODULE
/end PROJECT
