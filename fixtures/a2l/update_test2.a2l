ASAP2_VERSION 1 71
/begin PROJECT test ""
/begin MODULE mod ""
/begin COMPU_METHOD uint16_Compu "" RAT_FUNC "%.0" "" COEFFS 0 1 0 0 0 1 /end COMPU_METHOD
/begin COMPU_METHOD uint32_Compu "" RAT_FUNC "%.0" "" COEFFS 0 1 0 0 0 1 /end COMPU_METHOD
/begin COMPU_METHOD float_Compu "" RAT_FUNC "%.3" "" COEFFS 0 1 0 0 0 1 /end COMPU_METHOD
/begin CHARACTERISTIC Curve_ExternalAxis_Bad_Recordlayout "" CURVE 0x0 Curve_ExternalAxis_RecordLayout_Nonxistent 0 float_Compu -10000000 10000000
 /begin AXIS_DESCR COM_AXIS NO_INPUT_QUANTITY uint32_Compu 5 0 4294967295 AXIS_PTS_REF Axis_0 /end AXIS_DESCR
 SYMBOL_LINK "Curve_ExternalAxis" 0 /end CHARACTERISTIC
/begin CHARACTERISTIC Curve_InternalAxis_bad_axis_size "" CURVE 0x0 Curve_InternalAxis_RecordLayout 0 float_Compu -10000000 10000000 /begin AXIS_DESCR STD_AXIS NO_INPUT_QUANTITY uint16_Compu 8 0 65535 /end AXIS_DESCR SYMBOL_LINK "Curve_InternalAxis" 0 /end CHARACTERISTIC
/begin CHARACTERISTIC Map_ExternalAxis_bad_datatype "" MAP 0x0 Map_ExternalAxis_RecordLayout 0 float_Compu -10000000 10000000
 /begin AXIS_DESCR COM_AXIS NO_INPUT_QUANTITY uint32_Compu 3 0 4294967295 AXIS_PTS_REF Axis_1 /end AXIS_DESCR
 /begin AXIS_DESCR COM_AXIS NO_INPUT_QUANTITY uint32_Compu 2 0 4294967295 AXIS_PTS_REF Axis_2 /end AXIS_DESCR
 SYMBOL_LINK "Map_ExternalAxis" 0 /end CHARACTERISTIC
/begin CHARACTERISTIC Map_InternalAxis "" MAP 0x0 Map_InternalAxis_RecordLayout 0 uint32_Compu 0 4294967295 /begin AXIS_DESCR STD_AXIS NO_INPUT_QUANTITY uint16_Compu 4 0 65535 /end AXIS_DESCR /begin AXIS_DESCR STD_AXIS NO_INPUT_QUANTITY uint16_Compu 3 0 65535 /end AXIS_DESCR /end CHARACTERISTIC
/begin CHARACTERISTIC Characteristic_ValBlk_matrix_dim "" VAL_BLK 0x0 float32_RecordLayout 0 float_Compu -10000000 10000000 SYMBOL_LINK "Characteristic_ValBlk" 0 MATRIX_DIM 5 6 7 /end CHARACTERISTIC
/begin CHARACTERISTIC Characteristic_Value_bad_limit "" VALUE 0x0 uint32_RecordLayout 0 float_Compu -10000000 10000000 SYMBOL_LINK "Characteristic_Value" 0 /end CHARACTERISTIC
/begin CHARACTERISTIC Characteristic_Value_nonexistant "" VALUE 0x0 uint32_RecordLayout 0 float_Compu 0 10000000 SYMBOL_LINK "Characteristic_Value_nonexistent" 0 /end CHARACTERISTIC
/begin AXIS_PTS Axis_0_bad_size "" 0x0 NO_INPUT_QUANTITY Axis_0_RecordLayout 0 uint32_Compu 55 0 4294967295 SYMBOL_LINK "Axis_0" 0 /end AXIS_PTS
/begin AXIS_PTS Axis_1_bad_datatype "" 0x0 NO_INPUT_QUANTITY Axis_1_RecordLayout 0 uint32_Compu 3 0 4294967295 SYMBOL_LINK "Axis_1" 0 /end AXIS_PTS
/begin AXIS_PTS Axis_2 "" 0x0 NO_INPUT_QUANTITY Axis_2_RecordLayout 0 uint32_Compu 2 0 4294967295 /end AXIS_PTS
/begin AXIS_PTS Axis_3_nonexistant "" 0x0 NO_INPUT_QUANTITY Axis_2_RecordLayout 0 uint32_Compu 2 0 4294967295 SYMBOL_LINK "Axis_nonexistant" 0 /end AXIS_PTS
/begin BLOB Blob_1_invalid_size "" 0x0 1280 SYMBOL_LINK "Blob_1" 0 /end BLOB
/begin BLOB Blob_2 "" 0x0 256 SYMBOL_LINK "Blob_2" 0 /end BLOB
/begin BLOB Blob_nonexistant "" 0x0 256 SYMBOL_LINK "Blob_nonexistant" 0 /end BLOB
/begin MEASUREMENT Measurement_Matrix_bad_missing_dim "" UBYTE NO_COMPU_METHOD 0 0 0 2 ECU_ADDRESS 0x0 SYMBOL_LINK "Measurement_Matrix" 0 /end MEASUREMENT
/begin MEASUREMENT Measurement_Value_bad_type "" SBYTE NO_COMPU_METHOD 0 0 0 2 ECU_ADDRESS 0x0 SYMBOL_LINK "Measurement_Value" 0 /end MEASUREMENT
/begin MEASUREMENT Measurement_Bitfield_bits1_wrong_bitmask "" ULONG NO_COMPU_METHOD 0 0 0 2 BIT_MASK 0x1FFFFF ECU_ADDRESS 0x0 SYMBOL_LINK "Measurement_Bitfield.bits_1" 0 /end MEASUREMENT
/begin MEASUREMENT Measurement_Bitfield_bits2 "" ULONG NO_COMPU_METHOD 0 0 0 2 BIT_MASK 0xFFFE0 ECU_ADDRESS 0x0 SYMBOL_LINK "Measurement_Bitfield.bits_2" 0 /end MEASUREMENT
/begin MEASUREMENT Measurement_Bitfield_bits3 "" ULONG NO_COMPU_METHOD 0 0 0 2 BIT_MASK 0xFF00000 ECU_ADDRESS 0x0 SYMBOL_LINK "Measurement_Bitfield.bits_3" 0 /end MEASUREMENT
/begin MEASUREMENT Measurement_Enum_missing_compu "" UBYTE NO_COMPU_METHOD 0 0 0 2 ECU_ADDRESS 0x0 SYMBOL_LINK "Enum_Value" 0 /end MEASUREMENT
/begin MEASUREMENT Measurement_nonexistant "" ULONG NO_COMPU_METHOD 0 0 0 2 ECU_ADDRESS 0x0 /end MEASUREMENT
/begin INSTANCE INSTANCE.Map_InternalAxis "instance for symbol Map_InternalAxis" UpdateTest_Map_InternalAxis 0x0 SYMBOL_LINK "Map_InternalAxis" 0 /end INSTANCE
/begin INSTANCE INSTANCE_bad_typeref "instance for symbol Map_InternalAxis" UpdateTest_Map_InternalAxis_x 0x0 SYMBOL_LINK "Map_InternalAxis" 0 /end INSTANCE
/begin INSTANCE INSTANCE_nonexistant "instance for symbol Map_InternalAxis" UpdateTest_Map_InternalAxis 0x0 SYMBOL_LINK "INSTANCE_nonexistant" 0 /end INSTANCE
/begin TYPEDEF_MEASUREMENT Measurement_ULong "" ULONG NO_COMPU_METHOD 0 0 0 4294967295 /end TYPEDEF_MEASUREMENT
/begin TYPEDEF_MEASUREMENT Measurement_UWord "" UWORD NO_COMPU_METHOD 0 0 0 65535 /end TYPEDEF_MEASUREMENT
/begin TYPEDEF_STRUCTURE UpdateTest_Map_InternalAxis "" 0x40 /begin STRUCTURE_COMPONENT x Measurement_UWord 0 MATRIX_DIM 4 SYMBOL_TYPE_LINK "x" /end STRUCTURE_COMPONENT /begin STRUCTURE_COMPONENT y Measurement_UWord 8 MATRIX_DIM 3 SYMBOL_TYPE_LINK "y" /end STRUCTURE_COMPONENT
 /begin STRUCTURE_COMPONENT value Measurement_ULong 16 MATRIX_DIM 3 4 SYMBOL_TYPE_LINK "value" /end STRUCTURE_COMPONENT
 SYMBOL_TYPE_LINK "UpdateTest_Map_InternalAxis" /end TYPEDEF_STRUCTURE
/begin RECORD_LAYOUT Axis_2_RecordLayout AXIS_PTS_X 1 ULONG INDEX_INCR DIRECT FIX_NO_AXIS_PTS_X 2 /end RECORD_LAYOUT
/begin RECORD_LAYOUT Axis_1_RecordLayout AXIS_PTS_X 1 FLOAT64_IEEE INDEX_INCR DIRECT FIX_NO_AXIS_PTS_X 3 /end RECORD_LAYOUT
/begin RECORD_LAYOUT Axis_0_RecordLayout AXIS_PTS_X 1 ULONG INDEX_INCR DIRECT FIX_NO_AXIS_PTS_X 5 /end RECORD_LAYOUT
/begin RECORD_LAYOUT Curve_ExternalAxis_RecordLayout FNC_VALUES 1 FLOAT32_IEEE ROW_DIR DIRECT /end RECORD_LAYOUT
/begin RECORD_LAYOUT Curve_InternalAxis_RecordLayout AXIS_PTS_X 1 UWORD INDEX_INCR DIRECT FNC_VALUES 2 FLOAT32_IEEE ROW_DIR DIRECT FIX_NO_AXIS_PTS_X 4 /end RECORD_LAYOUT
/begin RECORD_LAYOUT Map_ExternalAxis_RecordLayout FNC_VALUES 1 UWORD ROW_DIR DIRECT /end RECORD_LAYOUT
/begin RECORD_LAYOUT Map_InternalAxis_RecordLayout AXIS_PTS_X 1 UWORD INDEX_INCR DIRECT AXIS_PTS_Y 2 UWORD INDEX_INCR DIRECT FNC_VALUES 3 ULONG ROW_DIR DIRECT FIX_NO_AXIS_PTS_X 4 FIX_NO_AXIS_PTS_Y 3 /end RECORD_LAYOUT
/begin RECORD_LAYOUT uint32_RecordLayout FNC_VALUES 1 ULONG ROW_DIR DIRECT /end RECORD_LAYOUT
/begin RECORD_LAYOUT float32_RecordLayout FNC_VALUES 1 FLOAT32_IEEE ROW_DIR DIRECT /end RECORD_LAYOUT
/end MODULE
/end PROJECT
