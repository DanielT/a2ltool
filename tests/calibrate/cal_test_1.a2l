/* a2ltool 2.2.0 */ ASAP2_VERSION 1 71
/begin PROJECT new_project "description of project"
/begin MODULE new_module ""
/begin CHARACTERISTIC cal_double "characteristic for cal_double" VAL_BLK 0xC320 __FLOAT64_IEEE_Z 0 NO_COMPU_METHOD -1.7976931348623157e308 1.7976931348623157e308 MATRIX_DIM 2 /end CHARACTERISTIC
/begin CHARACTERISTIC cal_float "characteristic for cal_float" VALUE 0xC330 __FLOAT32_IEEE_Z 0 NO_COMPU_METHOD -3.4028234663852886e38 3.4028234663852886e38 /end CHARACTERISTIC
/begin CHARACTERISTIC cal_sleep_counts "characteristic for cal_sleep_counts" VAL_BLK 0xC340 __ULONG_Z 0 NO_COMPU_METHOD 0 4294967295 MATRIX_DIM 3 /end CHARACTERISTIC
/begin CHARACTERISTIC cal_sleep_time "characteristic for cal_sleep_time" VALUE 0xC34C __ULONG_Z 0 NO_COMPU_METHOD 0 4294967295 /end CHARACTERISTIC
/begin CHARACTERISTIC cal_text "characteristic for cal_text" VAL_BLK 0xC334 __UBYTE_Z 0 NO_COMPU_METHOD 0 255 MATRIX_DIM 12 /end CHARACTERISTIC
/begin RECORD_LAYOUT __FLOAT32_IEEE_Z FNC_VALUES 1 FLOAT32_IEEE ROW_DIR DIRECT /end RECORD_LAYOUT
/begin RECORD_LAYOUT __FLOAT64_IEEE_Z FNC_VALUES 1 FLOAT64_IEEE ROW_DIR DIRECT /end RECORD_LAYOUT
/begin RECORD_LAYOUT __UBYTE_Z FNC_VALUES 1 UBYTE ROW_DIR DIRECT /end RECORD_LAYOUT
/begin RECORD_LAYOUT __ULONG_Z FNC_VALUES 1 ULONG ROW_DIR DIRECT /end RECORD_LAYOUT
/end MODULE
/end PROJECT
